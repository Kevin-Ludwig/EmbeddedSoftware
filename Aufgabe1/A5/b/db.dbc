VERSION ""

NS_ :

BS_:

BU_:
VAL_TABLE_ vt_SFC 7 "SFC_SCS" 6 "SFC_NIS" 5 "SFC_NVS" 4 "SFC_BCS" 3 "SFC_DDS" 2 "SFC_DUS" 1 "SFC_NSS" 0 "SFC_IDS" ;
VAL_TABLE_ vt_PVS 3 "PVS_NO" 2 "PVS_FT" 1 "PVS_NCD" 0 "PVS_FW" ;

BO_ 66 message42: 2 Vector__XXX
 SG_ Signal4 : 8|8@1- (1,0) [0|0] "" Vector__XXX
 SG_ Signal3 : 0|8@1- (1,0) [0|0] "" Vector__XXX

BO_ 291 message123: 2 Vector__XXX
 SG_ Signal2 : 8|8@1- (1,0) [0|0] "" Vector__XXX
 SG_ Signal1 : 0|8@1- (1,0) [0|0] "" Vector__XXX

CM_ "DBC template for Option CANaero (ARINC 825-3)";
BA_DEF_ BU_  "NodeLayerModules" STRING ;
BA_DEF_ SG_  "A825SignalType" ENUM  "noPVS","PVSassigned","PVSvalue";
BA_DEF_ BO_  "A825MsgType" ENUM  "unspecific","PeriodicHealth","HighIntegrity";
BA_DEF_  "A825RCIBitSize" INT 0 2;
BA_DEF_ BU_  "CanEquipment" STRING ;
BA_DEF_  "TemplateVersion" STRING ;
BA_DEF_ SG_  "GenSigSendType" ENUM  "Cyclic","OnWrite","OnWriteWithRepetition","OnChange","OnChangeWithRepetition","IfActive","IfActiveWithRepetition","NoSigSendType","NotUsed","NotUsed","NotUsed","NotUsed","NotUsed";
BA_DEF_ BO_  "GenMsgSendType" ENUM  "Cyclic","NotUsed","NotUsed","NotUsed","NotUsed","Cyclic","NotUsed","IfActive","NoMsgSendType","NotUsed","vector_leerstring";
BA_DEF_ BO_  "GenMsgILSupport" ENUM  "No","Yes";
BA_DEF_  "ToolName" STRING ;
BA_DEF_  "ToolVersion" STRING ;
BA_DEF_  "VersionDay" INT 0 31;
BA_DEF_  "VersionWeek" INT 0 52;
BA_DEF_  "VersionMonth" INT 0 12;
BA_DEF_  "ProtocolType" STRING ;
BA_DEF_  "DBName" STRING ;
BA_DEF_  "BusType" STRING ;
BA_DEF_DEF_  "NodeLayerModules" "CANoeILNLVector.dll";
BA_DEF_DEF_  "A825SignalType" "noPVS";
BA_DEF_DEF_  "A825MsgType" "unspecific";
BA_DEF_DEF_  "A825RCIBitSize" 2;
BA_DEF_DEF_  "CanEquipment" "<unknown>";
BA_DEF_DEF_  "TemplateVersion" "2.8.4.0";
BA_DEF_DEF_  "GenSigSendType" "Cyclic";
BA_DEF_DEF_  "GenMsgSendType" "NoMsgSendType";
BA_DEF_DEF_  "GenMsgILSupport" "Yes";
BA_DEF_DEF_  "ToolName" "manually";
BA_DEF_DEF_  "ToolVersion" "2.0.0.0";
BA_DEF_DEF_  "VersionDay" 1;
BA_DEF_DEF_  "VersionWeek" 1;
BA_DEF_DEF_  "VersionMonth" 1;
BA_DEF_DEF_  "ProtocolType" "ARINC825V3";
BA_DEF_DEF_  "DBName" "";
BA_DEF_DEF_  "BusType" "CAN";
BA_ "DBName" "db";
