/*@!Encoding:1252*/
includes
{
  
}

variables
{
  int counter;
  message message42 msg42;
}


on message message123
{
  counter++;
  output(msg42);
  
  if (counter%10 == 0){
    write("Aktuelle Anzahl: %d", counter);
  }
}