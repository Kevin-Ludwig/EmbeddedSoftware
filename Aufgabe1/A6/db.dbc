VERSION ""

NS_ :

BS_:

BU_:

BO_ 66 message42: 8 Vector__XXX
 SG_ Signal4 : 8|8@1- (1,0) [0|0] "" Vector__XXX
 SG_ Signal3 : 0|8@1- (1,0) [0|0] "" Vector__XXX

BO_ 291 message123: 8 Vector__XXX
 SG_ Signal2 : 8|8@1- (1,0) [0|0] "" Vector__XXX
 SG_ Signal1 : 0|8@1- (1,0) [0|0] "" Vector__XXX

EV_ send: 0 [0|0] "" 0 1 DUMMY_NODE_VECTOR3 Vector__XXX;

EV_ lcd: 0 [0|0] "" 0 2 DUMMY_NODE_VECTOR3 Vector__XXX;
